## sdkconfig.defaults esp32
```kconfig
# Run the command : idf.py set-target esp32

# =====================================================================
# Specific configuration for ESP32-PICO-D4 (revision 1)
# =====================================================================

# Ensure dual-core mode is active
CONFIG_FREERTOS_UNICORE=n

# Flash Memory Configuration
CONFIG_ESPTOOLPY_FLASHSIZE_4MB=y
CONFIG_ESPTOOLPY_FLASHSIZE="4MB"
```

## sdkconfig.defaults.esp32c6
```kconfig
# Run the command : idf.py set-target esp32c6

# =====================================================================
# Specific configuration for ESP32-C6-DevKitC-1-N8
# =====================================================================

# ESP32-C6 is a Single-Core RISC-V processor
CONFIG_FREERTOS_UNICORE=y

# Flash Memory Configuration (N8 = 8 MB)
CONFIG_ESPTOOLPY_FLASHSIZE_8MB=y
CONFIG_ESPTOOLPY_FLASHSIZE="8MB"
CONFIG_ESPTOOLPY_FLASHMODE_QIO=y
CONFIG_ESPTOOLPY_FLASHFREQ_80M=y
```

## sdkconfig.defaults.esp32s3
```kconfig
# Run the command : idf.py set-target esp32s3

# =====================================================================
# Specific configuration for ESP32-S3-DevKitC-1U-N8R2
# =====================================================================

# Ensure dual-core mode is active
CONFIG_FREERTOS_UNICORE=n

# Flash Memory Configuration (N8 = 8 MB)
CONFIG_ESPTOOLPY_FLASHSIZE_8MB=y
CONFIG_ESPTOOLPY_FLASHSIZE="8MB"
CONFIG_ESPTOOLPY_FLASHMODE_DIO=y
CONFIG_ESPTOOLPY_FLASHFREQ_80M=y

# PSRAM Configuration (R2 = 2 MB Quad SPI)
CONFIG_SPIRAM=y
CONFIG_SPIRAM_TYPE_AUTO=y
CONFIG_SPIRAM_MODE_QUAD=y
CONFIG_SPIRAM_SPEED_80M=y

# Strategy: allocations >= 4KB go to PSRAM automatically
CONFIG_SPIRAM_USE_MALLOC=y

# Ensures memory alignment constraints are met for DMA
CONFIG_SPIRAM_MALLOC_ALWAYSALIGN=y
```
